## kernel/moker/Kconfig
```kconfig
menu "MOKER framework"

config MOKER_FRAMEWORK
bool "My Own Kernel Framework"
default y

config MOKER_TRACING
bool "MOKER tracing"
default y
depends on MOKER_FRAMEWORK

config MOKER_SCHED_CSS_POLICY
bool "MOKER scheduling policy: CSS"
default y
depends on MOKER_FRAMEWORK

endmenu
```
